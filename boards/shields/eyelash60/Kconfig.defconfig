## boards/shields/eyelash60/Kconfig.defconfig
```kconfig
if SHIELD_EYELASH60_DONGLE

config ZMK_KEYBOARD_NAME
    default "EYELASH60"

config ZMK_SPLIT_ROLE_CENTRAL
    default y

endif # SHIELD_EYELASH60_DONGLE

if SHIELD_EYELASH60_DONGLE || SHIELD_EYELASH60_PERIPHERAL

config ZMK_SPLIT
    default y

endif
```

## boards/shields/eyelash60/Kconfig.shield
```kconfig
# Copyright (c) 2020 The ZMK Contributors
# SPDX-License-Identifier: MIT

config SHIELD_EYELASH60_DONGLE
    def_bool $(shields_list_contains,eyelash60_dongle)

config SHIELD_EYELASH60_PERIPHERAL
    def_bool $(shields_list_contains,eyelash60_peripheral)
```
